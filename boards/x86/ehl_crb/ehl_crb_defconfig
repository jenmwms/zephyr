## boards/x86/ehl_crb/ehl_crb_defconfig
```kconfig
# SPDX-License-Identifier: Apache-2.0

CONFIG_SOC_ELKHART_LAKE=y
CONFIG_BOARD_EHL_CRB=y
CONFIG_PIC_DISABLE=y
CONFIG_LOAPIC=y
CONFIG_CONSOLE=y
CONFIG_SERIAL=y
CONFIG_UART_NS16550=y
CONFIG_UART_CONSOLE=y
CONFIG_X2APIC=y
CONFIG_SMP=y
CONFIG_BUILD_OUTPUT_EFI=y
CONFIG_BUILD_NO_GAP_FILL=y
CONFIG_APIC_TSC_DEADLINE_TIMER=y
CONFIG_HPET_TIMER=n
CONFIG_APIC_TIMER=n
CONFIG_SYS_CLOCK_HW_CYCLES_PER_SEC=1900000000
```
